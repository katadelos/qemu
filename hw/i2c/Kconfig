## hw/i2c/Kconfig
```kconfig
config I2C
    bool

config I2C_DEVICES
    # Device group for i2c devices which can reasonably be user-plugged
    # to any board's i2c bus
    bool

config SMBUS
    bool
    select I2C

config SMBUS_EEPROM
    bool
    select SMBUS

config ARM_SBCON_I2C
    bool
    select BITBANG_I2C

config ACPI_SMBUS
    bool
    select SMBUS

config BITBANG_I2C
    bool
    select I2C

config IMX_I2C
    bool
    select I2C

config FP9928
    bool
    select I2C

config ELAN_KTF2K
    bool
    select I2C

config GOODIX_GT813
    bool
    select I2C

config CY8C_SLIDER
    bool
    select I2C

config MSG2133
    bool
    select I2C

config KOBO_MSP430
    bool
    select I2C

config MAX77796
    bool
    select I2C

config MAX77696
    bool
    select I2C

config DRV2667
    bool
    select I2C

config CYTTSP4
    bool
    select I2C

config CYTTSP5
    bool
    select I2C

config PARADE_TT
    bool
    select I2C

config BMA2X2
    bool
    select I2C

config MMA7660
    bool
    select I2C

config MTK_I2C
    bool
    select I2C

config MPC_I2C
    bool
    select I2C

config ALLWINNER_I2C
    bool
    select I2C

config PCA954X
    bool
    select I2C

config PMBUS
    bool
    select SMBUS

config BCM2835_I2C
    bool
    select I2C

config BD71827
    bool
    select I2C

config FP9929
    bool
    select I2C

config GOODIX_GT9XX
    bool
    select I2C

config LM3695
    bool
    select I2C

config LM3630A
    bool
    select I2C

config KOBO_NTX_PMIC
    bool
    select I2C

config LM3697
    bool
    select I2C

config AW99703
    bool
    select I2C

config TMP103
    bool
    select I2C

config MAX14656
    bool
    select I2C

config WACOM_EMR
    bool
    select I2C

config BD71815
    bool
    select I2C

config SY7636
    bool
    select I2C
```

## hw/sd/Kconfig
```kconfig
config PL181
    bool
    select SD

config SSI_SD
    bool
    depends on SSI
    select SD

config SD
    bool

config MTK_MSDC
    bool
    select SD

config SDHCI
    bool
    select SD

config SDHCI_PCI
    bool
    default y if PCI_DEVICES
    depends on PCI
    select SDHCI

config CADENCE_SDHCI
    bool
    select SDHCI
```
